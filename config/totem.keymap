#define HOST_OS 2

#include <behaviors.dtsi>
#include <dt-bindings/zmk/bt.h>
#include <dt-bindings/zmk/keys.h>
#include <dt-bindings/zmk/outputs.h>
#include "zmk-helpers/helper.h"
#include "zmk-helpers/key-labels/totem.h"
#include "zmk-helpers/macros.h"

&sk {  // sticky-key config
    release-after-ms = <900>;  // release after 0.9s
    quick-release;             // no double capitalization when rolling keys
};

&sl {  // sticky-layer config
    ignore-modifiers;          // allow chording sticky mods & layers
};

< {  // layer-tap config
    flavor = "balanced";
    tapping-term-ms = <200>;
    quick-tap-ms = <QUICK_TAP_MS>;
};

/*                                      38 KEY MATRIX / LAYOUT MAPPING

    ╭────────────────────┬────────────────────╮        ╭──────────────────────┬─────────────────────╮
    │  0   1   2   3   4 │  5   6   7   8   9 │        │  LT4 LT3 LT2 LT1 LT0 │ RT0 RT1 RT2 RT3 RT4 │
 ╭──╯ 10  11  12  13  14 │ 15  16  17  18  19 ╰───╮ ╭──╯  LM4 LM3 LM2 LM1 LM0 │ RM0 RM1 RM2 RM3 RM4 ╰───╮
 │ 20 21  22  23  24  25 │ 26  27  28  29  30  31 │ │ LB5 LB4 LB3 LB2 LB1 LB0 │ RB0 RB1 RB2 RB3 RB4 RB5 │
 ╰──────────╮ 32  33  34 │ 35  36  37 ╭───────────╯ ╰──────────╮  LH2 LH1 LH0 │ RH0 RH1 RH2 ╰───╮
            ╰────────────┴────────────╯                        ╰──────────────┴─────────────╯
*/

/* Timeless homerow mods */
// https://github.com/urob/zmk-config/tree/main#timeless-homerow-mods

MAKE_HRM(hml, &kp, &kp, KEYS_R THUMBS)  // left-hand HRMs
MAKE_HRM(hmr, &kp, &kp, KEYS_L THUMBS)  // right-hand HRMs
MAKE_HRM(hml_layer, &mo, &kp, KEYS_R THUMBS) // switch layer like HRM

&mt {
    quick-tap-ms = <100>;
    global-quick-tap;
    flavor = "tap-preferred";
    tapping-term-ms = <170>;
};

/ {
    combos {
        compatible = "zmk,combos";
        caps_lock {
            bindings = <&caps_word>;
            key-positions = <LM3 LM2 LM1>;
            timeout-ms = <100>;
            require-prior-idle-ms = <150>;
        };
    };

    behaviors {
        all_quotes: all_quotes {
            compatible = "zmk,behavior-tap-dance";
            #binding-cells = <0>;
            tapping-term-ms = <200>;
            bindings = <&mt GRAVE SQT>, <&kp DOUBLE_QUOTES>;
        };
    };

    keymap {
        compatible = "zmk,keymap";

        Norman {
            label = "BASE";
            bindings = <
//          ╭──────────────┬─────────────┬───────────────┬─────────────────┬─────────────╮        ╭─────────────┬──────────────────┬──────────────┬──────────────────┬──────────────────────╮
              &kp Q          &kp W         < 3 D         &kp F             &kp K                  &kp J         &kp U              < 3 R        &kp L              &mt COLON SEMI
//          ├──────────────┼─────────────┼───────────────┼─────────────────┼─────────────┤        ├─────────────┼──────────────────┼──────────────┼──────────────────┼──────────────────────┤
              &hml LCTRL A   &hml LALT S   &hml LSHFT E  &hml_layer 2 T    &kp G                  &kp Y         &hmr RIGHT_GUI N   &hmr RSHFT I   &hmr RIGHT_ALT O   &hmr RIGHT_CONTROL H
// ╭────────┼──────────────┼─────────────┼───────────────┼─────────────────┼─────────────┤        ├─────────────┼──────────────────┼──────────────┼──────────────────┼──────────────────────┼─────────────────────────────────╮
     &kp TAB  &kp Z          &kp X         &kp C           &kp V             &kp B                  &kp P         &kp M              &kp COMMA      &kp DOT            &kp SLASH              &all_quotes
// ╰────────┴──────────────┴─────────────┼───────────────┼─────────────────┼─────────────┤        ├─────────────┼──────────────────┼──────────────┼──────────────────┴──────────────────────┴─────────────────────────────────╯
                                           &sk LEFT_SHIFT  &sk LEFT_COMMAND  &kp SPACE              &kp RET       < 4 ESC          &mo 3
//                                       ╰───────────────┴─────────────────┴─────────────╯        ╰─────────────┴──────────────────┴──────────────╯
            >;
        };

        Navigation {
            label = "Navigation";
            bindings = <
//          ╭──────────────┬───────────────────────┬──────────────────────┬───────────────────┬─────────────╮        ╭─────────────┬──────────────────┬──────────────┬──────────────────┬──────────────────────╮
              ___            &kp LS(LG(NUMBER_3))    &kp LS(LG(NUMBER_4))   ___                 ___                    &none         &kp HOME           &kp UP         &kp END            &kt PAGE_UP
//          ├──────────────┼───────────────────────┼──────────────────────┼───────────────────┼─────────────┤        ├─────────────┼──────────────────┼──────────────┼──────────────────┼──────────────────────┤
              ___            ___                     ___                    ___                 ___                    &kp LA(LEFT)  &kp LEFT           &kp DOWN       &kp RIGHT          &kp LA(RIGHT)
// ╭────────┼──────────────┼───────────────────────┼──────────────────────┼───────────────────┼─────────────┤        ├─────────────┼──────────────────┼──────────────┼──────────────────┼──────────────────────┼──────────────────╮
     ___      ___            ___                     ___                    ___                 ___                    &none         &kp LA(LEFT)       &none          &kp LA(RIGHT)      &kt PAGE_DOWN          ___
// ╰────────┴──────────────┴───────────────────────┼──────────────────────┼───────────────────┼─────────────┤        ├─────────────┼──────────────────┼──────────────┼──────────────────┴──────────────────────┴──────────────────╯
                                                     ___                    ___                 ___                    ___           ___                ___
//                                                 ╰──────────────────────┴───────────────────┴─────────────╯        ╰─────────────┴──────────────────┴──────────────╯
            >;
        };

        digits {
            label = "Digits";
            bindings = <
//          ╭────────────────────────┬──────────────────────┬────────────────────────────┬──────────────────────────────┬────────────────────────────────────╮        ╭────────────────┬──────────────────┬──────────────┬──────────────────┬──────────────────────╮
              &kp PIPE                 &kp DOLLAR             &kp LEFT_BRACE               &kp RIGHT_BRACE                &none                                          &kp PLUS         &kp N7             &kp N8         &kp N9             &kp SEMI
//          ├────────────────────────┼──────────────────────┼────────────────────────────┼──────────────────────────────┼────────────────────────────────────┤        ├────────────────┼──────────────────┼──────────────┼──────────────────┼──────────────────────┤
              &hml LCTRL EXCLAMATION  &hml LEFT_ALT AT_SIGN   &hml LSHFT LEFT_PARENTHESIS  < 2 RIGHT_PARENTHESIS      &none                                          &kp EQUAL        &kp N4             &kp N5         &kp N6             &kp KP_MULTIPLY
// ╭────────┼────────────────────────┼──────────────────────┼────────────────────────────┼──────────────────────────────┼────────────────────────────────────┤        ├────────────────┼──────────────────┼──────────────┼──────────────────┼──────────────────────┼──────────────────╮
     ___      &kp AMPERSAND           &kp LCTRL              &mt LESS_THAN LEFT_BRACKET   &mt GREATER_THAN RIGHT_BRACKET  &none                                          &mt UNDER MINUS  &kp N1             &kp N2         &kp N3             &kp PERIOD             &kp SLASH
// ╰────────┴────────────────────────┴──────────────────────┼────────────────────────────┼──────────────────────────────┼────────────────────────────────────┤        ├────────────────┼──────────────────┼──────────────┼──────────────────┴──────────────────────┴──────────────────╯
                                                              ___                            ___                          ___                                            ___             &kp N0             ___
//                                                          ╰────────────────────────────┴──────────────────────────────┴────────────────────────────────────╯        ╰────────────────┴──────────────────┴──────────────╯
            >;
        };

        sim_layer {
            label = "SYSTEM";
            bindings = <
//          ╭─────────┬─────────┬──────────────┬────────────┬─────────────╮        ╭─────────────┬──────────────┬────────────┬────────────┬──────────╮
            &kp F1    &kp F2    &kp F3         &kp F4       &kp F5                 &kp F6        &kp F7         &kp F8       &kp F9       &kp F10
//          ├─────────┼─────────┼──────────────┼────────────┼─────────────┤        ├─────────────┼──────────────┼────────────┼────────────┼──────────┤
           ___        ___       ___            ___          ___                    &kp C_MUTE    &kp C_PP       ___          ___          ___
// ╭──────────┼─────────┼─────────┼──────────────┼────────────┼─────────────┤        ├─────────────┼──────────────┼────────────┼────────────┼──────────┼──────────╮
    &bt BTCLR  ___      ___        &out OUT_TOG   &bt BT_PRV   &bt BT_NXT             &kp C_VOL_DN  &kp C_VOL_UP   &kp C_PREV   &kp C_NEXT   ___       ___
// ╰──────────┴─────────┴─────────┼──────────────┼────────────┼─────────────┤        ├─────────────┼──────────────┼────────────┼────────────┴──────────┴──────────╯
                                  ___            ___          ___                    ___           ___             ___
//                              ╰──────────────┴────────────┴─────────────╯        ╰─────────────┴──────────────┴────────────╯
            >;
        };
    };
};